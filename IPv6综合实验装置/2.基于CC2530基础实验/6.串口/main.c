/**
************************************************************
************************************************************
************************************************************
*
*	作者： 		重庆八城科技
*
*	日期： 		2019-12-25
*
*	版本： 		V1.0
*
*	说明： 		串口实验
*
*	修改记录：	
************************************************************
************************************************************
************************************************************
**/

#include <ioCC2530.h>
#include <stdlib.h>
#include <string.h>
#include "Usart.h"
#include "delay.h"
#include "Lamp.h"

//==========================================================
//	函数名称：	main()
//
//	函数功能：	程序入口函数
//
//	入口参数：	无
//
//	返回参数：	无
//
//	说明：		
//==========================================================

void main(void)
{
    Hal_Init_32M();   //初始化32M时钟
    LampInit();       //底座灯初始化
    Init_Uart0();     //初始化串口0-115200
    
    //先发送一个字符串，测试串口0数据传输是否正确
    UR0SendString("八城物联\r\n");

    while(1)              
    {
        if(USART0_RX_STA)
        {
		  delay_ms(100);
		  if(USART0_RX_STA){
			UR0SendString(USART0_RX_BUF); //发送接收到的数据
			USART0_RX_STA = 0;            //清空接收标志位
			memset(USART0_RX_BUF,0,200);
		  }
        }
    }
}



