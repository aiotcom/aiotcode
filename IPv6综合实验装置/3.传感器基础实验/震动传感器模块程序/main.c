/**
************************************************************
************************************************************
************************************************************
*
*	作者： 		重庆八城科技
*
*	日期： 		2020-01-09
*
*	版本： 		V2.0
*
*	说明： 		震动模块实验
*
*	修改记录：	
************************************************************
************************************************************
************************************************************
**/

#include <ioCC2530.h>
#include "Vibration.h"
#include "OLEDIIC.h"
#include "Usart.h"	
#include "delay.h"
#include "Rs485.h"
#include "OLED.h"
#include "Lamp.h"

//==========================================================
//	函数名称：	main()
//
//	函数功能：	程序入口函数
//
//	入口参数：	无
//
//	返回参数：	无
//
//	说明：		
//==========================================================
void main(void)
{
    Hal_Init_32M();     //初始化32M时钟
    Vibration_Init();	//初始化震动传感器
    OLED_IIC_Init();    //初始化OLED_I2C
    OLED_Init();        //初始化OLED屏
    LampInit();         //初始化底座灯
    OLED_Init_UI();     //初始化显示界面 

    while(1)
    {
        if(!Vibration_State0 || !Vibration_State1)//读取震动状态
        {
          if(!Vibration_State0 && !Vibration_State1)
            OLED_P8x16Str(60,6,"OK  ");
        }
        else
        {
            OLED_P8x16Str(60,6,"NULL");
        }
    }
}
