/**
************************************************************
************************************************************
************************************************************
*
*	作者： 		重庆八城科技
*
*	日期： 		2019-12-20
*
*	版本： 		V2.0
*
*	说明： 		蓝牙实验
*
*	修改记录：	
************************************************************
************************************************************
************************************************************
**/

#include <ioCC2530.h>
#include "Usart.h"
#include "delay.h"
#include "Time.h"
#include "Lamp.h"
#include "Ble.h"

//==========================================================
//	函数名称：	main()
//
//	函数功能：	程序入口函数
//
//	入口参数：	无
//
//	返回参数：	无
//
//	说明：		
//==========================================================
void main(void)
{
    Hal_Init_32M();       //初始化32M时钟
    LampInit();           //底座灯初始化
    Set_Blue();           //底座灯蓝色
    Init_Uart0();         //初始化串口0
    Init_Timer1();        //初始化定时器1(10ms)
    BLE_Init(0);          //初始化蓝牙为从机模式
	
	while(!strstr((const char*)USART0_RX_BUF,(const char*)"Connected"));
    while(1)
    {
        if(USART0_RX_STA)
        {
	      delay_ms(500);
          UR0SendString(USART0_RX_BUF); //发送接收到的数据
          USART0_RX_STA = 0;            //清空接收标志位
          memset(USART0_RX_BUF,0,200);
        }
    }
}
